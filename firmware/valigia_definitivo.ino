//RX
#include <Keypad.h>           // libreria per l'utilizzo del tastierino
#include <ezBuzzer.h>         // libreria per l'utilizzo del cicalino
#include <string.h>           // libreria per l'utilizzo delle funzioni stringa
#include <HardwareSerial.h>   // libreria per l'utilizzo delle porte hardware seriali
#include "EBYTE.h"            // libreria per l'utilizzo del modulo LoRa
#include <SPI.h>              // libreria per l'utilizzo del display i2c
#include <Adafruit_GFX.h>     // libreria per l'utilizzo di dunzioni grafiche del display
#include <Adafruit_SH110X.h>  // libreria per l'utilizzo del display i2c e garantirne la compatibilità
#include <Wire.h>             // libreria per l'utilizzo del wiring automatico


#define i2c_Address 0x3c                                                                      // indico l'indirizzo del mio display
#define SCREEN_WIDTH 128                                                                      // definisco la sua larghezza in pixel
#define SCREEN_HEIGHT 64                                                                      // definisco l'altezza in pixel
#define OLED_RESET -1                                                                         //   QT-PY / XIA
Adafruit_SH1106G display = Adafruit_SH1106G(SCREEN_WIDTH, SCREEN_HEIGHT, &Wire, OLED_RESET);  // oggetto display che ne riporta tutte le caratteristiche
// 'download', 128x64px
const unsigned char myBitmapdownload[] PROGMEM = {  // questa struttura mi permette di visualizzare una immagine particolare
  0x00, 0x00, 0x00, 0x00, 0x00, 0x00, 0x00, 0x00, 0x00, 0x00, 0x00, 0x00, 0x00, 0x00, 0x00, 0x00,
  0x00, 0x00, 0x00, 0x00, 0x00, 0x00, 0x00, 0x00, 0x00, 0x00, 0x00, 0x00, 0x00, 0x00, 0x00, 0x00,
  0x00, 0x00, 0x00, 0x00, 0x00, 0x00, 0x00, 0x00, 0x00, 0x00, 0x00, 0x00, 0x00, 0x00, 0x00, 0x00,
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  0x00, 0x00, 0x00, 0x00, 0x00, 0x00, 0x00, 0x00, 0x00, 0x00, 0x00, 0x00, 0x00, 0x00, 0x00, 0x00
};  // vengono stabiliti quali pixels devono rimanere accesi o spenti sigolarmente con il codice esadecimale

// qui utilizzo un vettore contenente tutti le mie immagini (totali:1)
const int myBitmapallArray_LEN = 1;
const unsigned char* myBitmapallArray[1] = {
  myBitmapdownload
};

#define BUZZER 15         //definisco il pin a cui il cicalino è connesso
ezBuzzer buzzer(BUZZER);  // creo l'oggetto buzzer utile all'utilizzo della libreria ezBuzzer (che non utilizza alcun delay)

#define RIGHE 4    // griglia keypad righe
#define COLONNE 3  // griglia keypad colonne

#define SUONO_OK 19     // definisco il pin per il quale l'esp32 dovrà mettere un segnale alto se il codice è corretto
#define OK_IMPRONTE 34  // definisco il pin per il quale se l'esp32 rileva che il sensore di impronte digitali ha rilevato una impronta registrata, allora apro la serratura
#define SUONO_noOK 2    // definisco il pin per il quale l'esp32 dovrà mettere un segnale alto se il codice NON è corretto

#define PIN_RX 16  // pin LoRa
#define PIN_TX 17
#define PIN_M0 4
#define PIN_M1 23
#define PIN_AX 5

struct DATA {         // struttura dati da inviare o ricevere (deve essere contenuta in tutti e due i moduli)
  bool aperto;        // con "aperto" capisco se la valigia è stata aperta 0 = chiusa / 1 = aperta
  String passwordTX;  // "passwordTX" è la password trasmessa. Una password ogni volta che viene aperta la valigia
  bool connesso;      // "connesso" mi permette di capire se sono ancora connesso all'altro modulo
};

int Chan;     // variabile canale, per cambiare frequenza. Il modulo è stato impostato sul canale 17 => 433MHz (Frequenza base) + 17MHz = 450MHZ
DATA MyData;  // rinomino la struttura dati

unsigned long Last, noconnected;  // questi sono tre timer utili per controlli
long t = 0;

EBYTE Transceiver(&Serial2, PIN_M0, PIN_M1, PIN_AX);  // creo l'oggetto trasmettitore

char keys[RIGHE][COLONNE] = {  // creo una matrice del valore di ogni pin della tastiera
  { '1', '2', '3' },
  { '4', '5', '6' },
  { '7', '8', '9' },
  { '*', '0', '#' }
};

byte pin_righe[RIGHE] = { 33, 25, 26, 27 };  // definisco per quali pin corrispondono ogni riga e colonna
byte pin_colonne[COLONNE] = { 14, 12, 13 };
Keypad keypad = Keypad(makeKeymap(keys), pin_righe, pin_colonne, RIGHE, COLONNE);  // creo l'oggetto keypad

void setup() {
  pinMode(SUONO_OK, OUTPUT);  //definisco output e input
  pinMode(SUONO_noOK, OUTPUT);
  pinMode(OK_IMPRONTE, INPUT);
  Serial.begin(9600);  //inizializzo tutti i seriali, display e modulo LoRa
  Serial2.begin(9600);
  Serial.println("Starting Reader");

  display.begin(i2c_Address, true);
  display.display();  // ogni volta che disegno
  delay(1000);
  // Clear the buffer.
  display.clearDisplay();
  display.println("");
  display.display();
  Transceiver.init();
  Transceiver.PrintParameters();
}

String password = "1234";              // stringa password a cui viene dato un primo pin per iniziare tutto
String input_password = "";            // la stringa input password è la password digitata
bool nobuono;                          // "nobuono" mi dice se siamo connessi o meno all'altro modulo LoRa
unsigned long int timer_impronta = 0;  // timer multitasking per la visualizzazione di immagini
unsigned long int scritta = 0;
unsigned long int delei = 0;
unsigned long int vario = 0;
bool apro = false;
bool welc = false;
bool incpass = false;
void loop() {
  buzzer.loop();
  if (Serial2.available()) {  // se leggo dei dati sulla porta seriale -> allora estrapolo le informazioni
    Transceiver.GetStruct(&MyData, sizeof(MyData));
    Serial.print("password: ");
    Serial.println(MyData.passwordTX);
    password = MyData.passwordTX;  // la password presa dalla struttura dati acquisita sarà = a quella da utilizzare
    Last = millis();
  } else {
    if ((millis() - Last >= 7000) and MyData.connesso == false) {
      if (millis() - noconnected >= 500) {  // altrimenti se non ricevo nulla da 7 secondi E non siamo connessi -> allora vengo avvisato di utilizzare le impronte digitali e che ho perso la connessione
        noconnected = millis();
        Serial.println("not connected");
        nobuono = true;  // aggiungi micro pin
        if (millis() - scritta >= 5000) {
          scritta = millis();
          display.clearDisplay();  // clear display
          display.display();
          display.setTextSize(1);
          display.setTextColor(SH110X_WHITE);
          display.setCursor(0, 0);
          display.println("CONNESSIONE PERSA");

          display.setTextSize(2);
          display.setTextColor(SH110X_WHITE);
          display.setCursor(0, 0);
          display.print("             LOST   ");
          display.println("CONNECTION");
          display.setTextSize(1);
          display.println("Use fingerprint...");
          display.display();
        }
        if (millis() - timer_impronta >= 10000) {
          timer_impronta = millis();
          display.clearDisplay();
          display.display();
          display.drawBitmap(0, 0, myBitmapdownload, 128, 64, SH110X_WHITE);
          display.display();
        }
      }
    } else {
      MyData.connesso = false;
      nobuono = false;
    }
  }

  char key = keypad.getKey();    // leggi il pulsante premuto
  if (nobuono == false) {        // solo se siamo connessi eseguo il controllo sul tastierino
    if (key) {
      buzzer.beep(100);  //fai un beep (non utilizza delay)
      Serial.println(key);
      if (key == '#') {
        if (input_password == password) {  // se la password è corretta -> allora scrivi sul display Benvenuto e apri la valigia
          display.clearDisplay();
          Serial.println("password corretta");
          digitalWrite(SUONO_OK, 1);
          display.setTextSize(2);
          display.setTextColor(SH110X_WHITE);
          display.setCursor(0, 0);
          display.println("Welcome Mr");
          display.println(" Minguzzi");
          display.display();
          delei = millis();
          apro = true;
          welc = true;
          vario = millis();
          // apro serratura
        } else {  // altrimenti dimmi che la password non era giusta
          display.clearDisplay();
          Serial.println("password incorretta");  // mettere musichetta di micro
          display.setTextSize(2);
          display.setTextColor(SH110X_WHITE);
          display.setCursor(0, 0);
          display.println(" INCORRECT");
          display.println(" PASSWORD");
          display.display();
          digitalWrite(SUONO_noOK, 1);
          delay(500);
          digitalWrite(SUONO_noOK, 0);
          Serial.println(input_password);
          Serial.println(password);
          vario = millis();
          incpass = true;
        }
        input_password = "";  // reset input password
      } else {
        input_password += key;  // metti nuovo cartattere e mostramelo sul display
        display.clearDisplay();
        display.setTextSize(4);  // ci stanno10 caratteri su due righe e 5 su. una
        display.setTextColor(SH110X_WHITE);
        display.setCursor(0, 0);
        display.print(input_password);
        display.display();
      }
    }
  }
  
    if (millis() - delei >= 1000 and apro) {
    apro = false;
    digitalWrite(SUONO_OK, 0);
    MyData.aperto = true;  //dico che è stata aperta la valigia e lo trasmetto all'altro modulo attendendo una nuova password
    Transceiver.SendStruct(&MyData, sizeof(MyData));
  }

  if((nobuono == false) and (millis()- vario >= 7000) and (incpass or welc)){
    incpass = false;
    welc = false;
    display.clearDisplay();
    display.display();
  }

  if (nobuono) {                     // se non siamo connessi utilizzo le impronte digitali
    if (digitalRead(OK_IMPRONTE)) {  // se leggo che dall'arduino micro sono state rilevate delle impronte giuste
      digitalWrite(19, 1);           // apro serratura
      delay(1000);
      digitalWrite(19, 0);
      nobuono = false;  // questa operazione vale solo una volta
      Serial.println("apero");
    }
  }
}
